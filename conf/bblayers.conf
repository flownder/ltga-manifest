## conf/bblayers.conf
```bitbake
# LAYER_CONF_VERSION is increased each time build/conf/bblayers.conf
# changes incompatibly
LCONF_VERSION = "7"

BBPATH = "${TOPDIR}"
BBFILES ?= ""

BBLAYERS ?= " \
  ##OEROOT##/sources/meta-openembedded/meta-filesystems \
  ##OEROOT##/sources/meta-openembedded/meta-multimedia \
  ##OEROOT##/sources/meta-openembedded/meta-networking \
  ##OEROOT##/sources/meta-openembedded/meta-python \
  ##OEROOT##/sources/meta-openembedded/meta-gnome \
  ##OEROOT##/sources/meta-openembedded/meta-oe \
  ##OEROOT##/sources/meta-ti \
  ##OEROOT##/sources/meta-arm/meta-arm \
  ##OEROOT##/sources/meta-arm/meta-arm-toolchain \
  ##OEROOT##/sources/oe-core/meta \
  "
```
